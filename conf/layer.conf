## conf/layer.conf
```bitbake
# We have a conf and classes directory, add to BBPATH
BBPATH .= ":${LAYERDIR}"

# We have recipes-* directories, add to BBFILES
BBFILES += "${LAYERDIR}/recipes-*/*/*.bb \
            ${LAYERDIR}/recipes-*/*/*.bbappend"

BBFILE_COLLECTIONS += "meta-grpc-example"
BBFILE_PATTERN_meta-grpc-example = "^${LAYERDIR}/"
BBFILE_PRIORITY_meta-grpc-example = "6"

LAYERDEPENDS_meta-grpc-example = "core"
LAYERSERIES_COMPAT_meta-grpc-example = "kirkstone"
```
